## lib/ac_charge/Kconfig
```kconfig
# SPDX-License-Identifier: Apache-2.0

config LIB_AC_CHARGE
    bool "AC charge"
    help
        Enable AC charge library for EVSE.

if LIB_CAN_DEMO

endif # LIB_CAN_DEMO

module = AC_CHARGE
module-str = AC charge library
source "subsys/logging/Kconfig.template.log_config"
```

## west.yml
```yaml
# SPDX-License-Identifier: Apache-2.0

# simplified manifest file

manifest:
  remotes:
    - name: zephyrproject-rtos
      url-base: https://github.com/zephyrproject-rtos
  projects:
    - name: zephyr
      remote: zephyrproject-rtos
      revision: v4.3-branch
      import:
        name-allowlist:
          - cmsis_6
          - fatfs
          - hal_nordic
          - hal_nxp
          - mbedtls
          - mcuboot
          - mcumgr
          - segger
          - tinycbor
          - tinycrypt
          - zcbor
```
